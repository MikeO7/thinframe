## image/buildroot/Config.in
```kconfig
source "$BR2_EXTERNAL_THINFRAME_PATH/package/tfctl/Config.in"
source "$BR2_EXTERNAL_THINFRAME_PATH/package/aic8800/Config.in"
```

## image/buildroot/configs/pf1007l_defconfig
```kconfig
# thinframe for the PF1007L (Allwinner A33). Buildroot 2025.02.18 LTS. Build: image/build.sh rootfs.
# Paths under ../work/inputs come from `image/build.sh inputs` (ormarch U-Boot, DTS, panel patch).
BR2_arm=y
BR2_cortex_a7=y
BR2_ARM_FPU_NEON_VFPV4=y
BR2_CCACHE=y
BR2_CCACHE_DIR="/ccache"
BR2_TOOLCHAIN_BUILDROOT_MUSL=y
BR2_KERNEL_HEADERS_6_12=y
BR2_TOOLCHAIN_BUILDROOT_CXX=y
BR2_TARGET_GENERIC_HOSTNAME="thinframe"
BR2_TARGET_GENERIC_ISSUE="thinframe"
BR2_INIT_BUSYBOX=y
BR2_ROOTFS_DEVICE_CREATION_DYNAMIC_EUDEV=y
# BR2_TARGET_ENABLE_ROOT_LOGIN is not set
# BR2_TARGET_GENERIC_REMOUNT_ROOTFS_RW is not set
BR2_SYSTEM_DHCP=""
BR2_TARGET_TZ_INFO=y
BR2_ROOTFS_USERS_TABLES="$(BR2_EXTERNAL_THINFRAME_PATH)/board/pf1007l/users.txt"
BR2_ROOTFS_OVERLAY="$(BR2_EXTERNAL_THINFRAME_PATH)/../rootfs"
BR2_ROOTFS_POST_BUILD_SCRIPT="$(BR2_EXTERNAL_THINFRAME_PATH)/board/pf1007l/post-build.sh"
BR2_ROOTFS_POST_IMAGE_SCRIPT="$(BR2_EXTERNAL_THINFRAME_PATH)/board/pf1007l/post-image.sh"
BR2_LINUX_KERNEL=y
BR2_LINUX_KERNEL_CUSTOM_VERSION=y
BR2_LINUX_KERNEL_CUSTOM_VERSION_VALUE="7.2.10"
BR2_LINUX_KERNEL_PATCH="$(BR2_EXTERNAL_THINFRAME_PATH)/../work/inputs/linux-patches"
BR2_LINUX_KERNEL_DEFCONFIG="sunxi"
BR2_LINUX_KERNEL_CONFIG_FRAGMENT_FILES="$(BR2_EXTERNAL_THINFRAME_PATH)/board/pf1007l/linux.fragment"
BR2_LINUX_KERNEL_ZIMAGE=y
BR2_LINUX_KERNEL_DTS_SUPPORT=y
BR2_LINUX_KERNEL_INTREE_DTS_NAME="allwinner/sun8i-h3-orangepi-pc"
BR2_LINUX_KERNEL_CUSTOM_DTS_DIR="$(BR2_EXTERNAL_THINFRAME_PATH)/../work/inputs/dts"
BR2_PACKAGE_BUSYBOX_CONFIG_FRAGMENT_FILES="$(BR2_EXTERNAL_THINFRAME_PATH)/board/pf1007l/busybox.fragment"
BR2_PACKAGE_MESA3D=y
BR2_PACKAGE_MESA3D_GALLIUM_DRIVER_LIMA=y
BR2_PACKAGE_MESA3D_GBM=y
BR2_PACKAGE_MESA3D_OPENGL_EGL=y
BR2_PACKAGE_MESA3D_OPENGL_ES=y
BR2_PACKAGE_DEJAVU=y
BR2_PACKAGE_COG=y
# BR2_PACKAGE_COG_PLATFORM_FDO is not set
BR2_PACKAGE_COG_PLATFORM_DRM=y
BR2_PACKAGE_WPEWEBKIT=y
BR2_PACKAGE_LIBDRM=y
BR2_PACKAGE_LIBINPUT=y
BR2_PACKAGE_E2FSPROGS=y
BR2_PACKAGE_E2FSPROGS_RESIZE2FS=y
BR2_PACKAGE_ZSTD=y
BR2_PACKAGE_CA_CERTIFICATES=y
BR2_PACKAGE_DHCPCD=y
BR2_PACKAGE_DROPBEAR=y
# BR2_PACKAGE_DROPBEAR_CLIENT is not set
BR2_PACKAGE_IWD=y
BR2_TARGET_ROOTFS_EXT2=y
BR2_TARGET_ROOTFS_EXT2_4=y
BR2_TARGET_ROOTFS_EXT2_LABEL="rootfs"
BR2_TARGET_ROOTFS_EXT2_SIZE="190M"
# BR2_TARGET_ROOTFS_TAR is not set
BR2_PACKAGE_HOST_DOSFSTOOLS=y
BR2_PACKAGE_HOST_GENIMAGE=y
BR2_PACKAGE_HOST_MTOOLS=y
BR2_PACKAGE_HOST_UBOOT_TOOLS=y
BR2_PACKAGE_TFCTL=y
BR2_PACKAGE_AIC8800=y
# No X, no wayland compositor, no dbus, no systemd, no package manager.
```

## image/buildroot/package/aic8800/Config.in
```kconfig
config BR2_PACKAGE_AIC8800
	bool "aic8800"
	depends on BR2_LINUX_KERNEL
	help
	  AIC8800DC SDIO Wi-Fi modules (aic8800_bsp, aic8800_fdrv) and
	  firmware, from the radxa-pkg commit ormarch pinned.
```

## image/buildroot/package/tfctl/Config.in
```kconfig
config BR2_PACKAGE_TFCTL
	bool "tfctl"
	help
	  thinframe control binary (prebuilt static armv7 musl from tfctl/).
```
